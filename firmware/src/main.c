#define _MAIN_C

#include <stddef.h>                     // Defines NULL
#include <stdbool.h>                    // Defines true
#include <stdlib.h>                     // Defines EXIT_FAILURE
#include "definitions.h"                // SYS function prototypes

#include "application.h"
#include "control_loop.h"
#include "adconv.h"
#include "leds.h"
#include "main.h"
#include "Protocol/protocol.h"
#include <math.h>


#define _1024_ms_TriggerTime 0x1
#define _512_ms_TriggerTime 0x2
#define _7820_us_TriggerTime 0x4
#define _15_64_ms_TriggerTime 0x8


void mosfetActivation(bool state){
    #ifndef MOSFET_SWITCH_ENABLED
        state = false;
    #endif

    if(state){ 
        uc_SHDOWN_Clear();
        LED_SWITCHING(true,0);
    }else{ 
        uc_SHDOWN_Set();        
        LED_SWITCHING(false,0);
    }
        

}

void outputActivation(bool state){
    // Disabilitazione generale
    #ifndef OUTPUT_SWITCH_ENABLED
        state = false;
    #endif     
            
    if(state){ 
        uC_VOUT_ENA_Clear();
        LED_OUTPUT(true,0);
    }else{ 
        uC_VOUT_ENA_Set();
        LED_OUTPUT(false,0);       
    }
}


volatile static uint8_t trigger_time = 0;

/**
 * This is the callback generated by the RTC module at the interrupt event.
 * 
 * @param intCause this is the cause of the interrupt event;
 * @param context this is the data pointer passed with the  RTC_Timer32CallbackRegister() routine;
 */
static void rtcEventHandler (RTC_TIMER32_INT_MASK intCause, uintptr_t context)
{
    // Periodic Interval Handler: Freq = 1024 / 2 ^ (n+3)
    
    if (intCause & RTC_TIMER32_INT_MASK_PER0) trigger_time |= _7820_us_TriggerTime;  // 7.82ms Interrupt
    if (intCause & RTC_TIMER32_INT_MASK_PER1) trigger_time |= _15_64_ms_TriggerTime; // 15.64ms Interrupt
    if (intCause & RTC_TIMER32_INT_MASK_PER6) trigger_time |= _512_ms_TriggerTime;  // 512 ms Interrupt
    if (intCause & RTC_TIMER32_INT_MASK_PER7) trigger_time |= _1024_ms_TriggerTime;  // 1024 ms Interrupt
    
}

unsigned char comando = 0;
static volatile float value;
static bool RESET =true;

int main ( void )
{
    /* Initialize all modules */
    SYS_Initialize ( NULL );
    RESET =true;
    
    
    
    // Output and switch disable
    outputActivation(false);
    mosfetActivation(false);
    
    
    WDT_Clear(); 
    
    // Registers the RTC interrupt routine to the RTC module
    RTC_Timer32CallbackRegister(rtcEventHandler, 0);
    RTC_Timer32Start(); // Start the RTC module
    
#ifdef CAN_BUS_ACTIVATION
    //Application Protocol initialization
    ApplicationProtocolInit();
#endif
    leds_init();
    adconv_init();
    control_init();
    
    #ifdef TEST_SWITCH 
    TC0_TimerCallbackRegister( TC0callback, 0 );
    #endif

    
    while( true )
    {
        /* Maintain state machines of all polled MPLAB Harmony modules. */
        SYS_Tasks ( );
               
        if(RESET){
            WDT_Clear();             
            if(trigger_time & _1024_ms_TriggerTime) RESET=false;
            else continue;
        }
        
        if(ADC0Exec)
        {
            ADC0ExecProcedure();
            ADC0Exec = false;
        }
        
        if(ControlExec)
        {
            ControlLoop();
            ControlExec = false;
        }
        
        
        // Protocol management
        #ifdef CAN_BUS_ACTIVATION
            ApplicationProtocolLoop();
        #endif
        
        //
               
        if(trigger_time & _1024_ms_TriggerTime){
            trigger_time &=~ _1024_ms_TriggerTime;            
                        
            VITALITY_LED_Toggle();
            
            #ifdef CAN_BUS_ACTIVATION
//                SystemACInputRegister.frequency = (unsigned char) inputFreq;
                value = adconv_get_max_vac();
                SystemACInputRegister.max_ac_L = (unsigned char) ((unsigned short) value) ;
                SystemACInputRegister.max_ac_H = (unsigned char) ((unsigned short) value >> 8) ;
                encodeStatusRegister(&SystemACInputRegister);

                value = (unsigned short) (adconv_get_vout());
                SystemDCOutRegister.vout_L = (unsigned char) ((unsigned short) value) ;
                SystemDCOutRegister.vout_H = (unsigned char) ((unsigned short) value >> 8) ;
                value = adconv_get_iout()*1000;
                SystemDCOutRegister.iout_L = (unsigned char) ((unsigned short) value) ;
                SystemDCOutRegister.iout_H = (unsigned char) ((unsigned short) value >> 8) ;
                encodeStatusRegister(&SystemDCOutRegister);
            #endif
            
            
        }     
        
        if(trigger_time & _512_ms_TriggerTime){
            trigger_time &=~ _512_ms_TriggerTime;            
            
          
            
        }     
 
        // Timer events activated into the RTC interrupt
        if(trigger_time & _7820_us_TriggerTime){
            trigger_time &=~ _7820_us_TriggerTime;
            
            
        }

        if(trigger_time & _15_64_ms_TriggerTime){
            trigger_time &=~ _15_64_ms_TriggerTime;      
 
            LedsControlLoop();
        }
       
    }

    /* Execution should not come here during normal operation */

    return ( EXIT_FAILURE );
}


/** @}*/
/*******************************************************************************
 End of File
*/

